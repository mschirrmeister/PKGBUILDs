## core/uboot-orangepi4-lts/orangepi_4_lts_rk3399_defconfig
```kconfig
CONFIG_CREATE_ARCH_SYMLINK=y
CONFIG_HAVE_SETJMP=y
CONFIG_SUPPORT_LITTLE_ENDIAN=y
CONFIG_SYS_CACHE_SHIFT_6=y
CONFIG_64BIT=y
CONFIG_SYS_CACHELINE_SIZE=64
CONFIG_LINKER_LIST_ALIGN=8
CONFIG_ARM=y
CONFIG_SYS_ARCH="arm"
CONFIG_SYS_CPU="armv8"
CONFIG_SYS_SOC="rk3399"
CONFIG_SYS_VENDOR="rockchip"
CONFIG_SYS_BOARD="evb_rk3399"
CONFIG_SYS_CONFIG_NAME="evb_rk3399"
CONFIG_SKIP_LOWLEVEL_INIT=y
CONFIG_ARM64=y
CONFIG_ARM64_CRC32=y
CONFIG_COUNTER_FREQUENCY=24000000
CONFIG_LNX_KRNL_IMG_TEXT_OFFSET_BASE=0x00200000
CONFIG_STATIC_RELA=y
CONFIG_DMA_ADDR_T_64BIT=y
CONFIG_ARM_ASM_UNIFIED=y
CONFIG_SYS_ARM_ARCH=8
CONFIG_SYS_ARM_CACHE_WRITEBACK=y
CONFIG_SYS_ARCH_TIMER=y
CONFIG_ARM_SMCCC=y
CONFIG_ENABLE_ARM_SOC_BOOT0_HOOK=y
CONFIG_ARM64_SUPPORT_AARCH32=y
CONFIG_ARCH_ROCKCHIP=y
CONFIG_TEXT_BASE=0x00200000
CONFIG_SYS_MALLOC_LEN=0x2000000
CONFIG_SYS_MALLOC_F_LEN=0x10000
CONFIG_SPL_GPIO=y
CONFIG_SPL_LIBCOMMON_SUPPORT=y
CONFIG_SPL_LIBGENERIC_SUPPORT=y
CONFIG_NR_DRAM_BANKS=1
CONFIG_SPL_LDSCRIPT="arch/arm/cpu/armv8/u-boot-spl.lds"
CONFIG_ENV_SOURCE_FILE=""
CONFIG_HAS_CUSTOM_SYS_INIT_SP_ADDR=y
CONFIG_CUSTOM_SYS_INIT_SP_ADDR=0x3f00000
CONFIG_SF_DEFAULT_SPEED=1000000
CONFIG_SF_DEFAULT_MODE=0x0
CONFIG_ENV_SIZE=0x8000
CONFIG_ENV_OFFSET=0x3F8000
CONFIG_DM_GPIO=y
CONFIG_SPL_DM_SPI=y
CONFIG_DEFAULT_DEVICE_TREE="rockchip/rk3399-orangepi"
CONFIG_OF_LIBFDT_OVERLAY=y
CONFIG_MULTI_DTB_FIT_UNCOMPRESS_SZ=0x8000
CONFIG_DM_RESET=y
CONFIG_SYS_MONITOR_LEN=0
CONFIG_ROCKCHIP_RK3399=y
CONFIG_TPL_ROCKCHIP_BACK_TO_BROM=y
CONFIG_ROCKCHIP_COMMON_BOARD=y
CONFIG_SPL_ROCKCHIP_COMMON_BOARD=y
CONFIG_TPL_ROCKCHIP_COMMON_BOARD=y
CONFIG_ROCKCHIP_EXTERNAL_TPL=y
CONFIG_ROCKCHIP_BOOT_MODE_REG=0xff320300
CONFIG_ROCKCHIP_STIMER=y
CONFIG_ROCKCHIP_STIMER_BASE=0xff8680a0
CONFIG_ROCKCHIP_SPL_RESERVE_IRAM=0x0
CONFIG_ROCKCHIP_BROM_HELPER=y
CONFIG_ROCKCHIP_DISABLE_FORCE_JTAG=y
CONFIG_SPL_MMC=y
CONFIG_ROCKCHIP_COMMON_STACK_ADDR=y
CONFIG_SPL_SERIAL=y
CONFIG_TPL_LDSCRIPT="arch/arm/mach-rockchip/u-boot-tpl-v8.lds"
CONFIG_TPL_TEXT_BASE=0xff8c2000
CONFIG_TPL_STACK=0xff8effff
CONFIG_TPL_SYS_MALLOC_F_LEN=0x4000
CONFIG_TPL_LIBCOMMON_SUPPORT=y
CONFIG_TPL_LIBGENERIC_SUPPORT=y
CONFIG_TPL_SERIAL=y
CONFIG_SPL_STACK_R_ADDR=0x3e00000
CONFIG_TARGET_EVB_RK3399=y
CONFIG_TPL_SYS_MALLOC_F=y
CONFIG_SPL_SYS_MALLOC_F_LEN=0x8000
CONFIG_SPL_TEXT_BASE=0x0
CONFIG_SPL_HAS_BSS_LINKER_SECTION=y
CONFIG_SPL_BSS_START_ADDR=0x3f80000
CONFIG_SPL_BSS_MAX_SIZE=0x8000
CONFIG_SPL_STACK_R=y
CONFIG_SPL_STACK_R_MALLOC_SIMPLE_LEN=0x200000
CONFIG_SYS_BOOTM_LEN=0x4000000
CONFIG_SYS_LOAD_ADDR=0x800800
CONFIG_WATCHDOG_TIMEOUT_MSECS=60000
CONFIG_SPL_OF_LIBFDT_ASSUME_MASK=0xff
CONFIG_SF_DEFAULT_BUS=0
CONFIG_SF_DEFAULT_CS=0
CONFIG_SPL_SYS_MALLOC_F=y
CONFIG_ERR_PTR_OFFSET=0x0
CONFIG_SPL_SIZE_LIMIT=0x0
CONFIG_SPL=y
CONFIG_PRE_CON_BUF_ADDR=0x0f200000
CONFIG_PRE_CON_BUF_SZ=4096
CONFIG_DEBUG_UART_BASE=0xFF1A0000
CONFIG_DEBUG_UART_CLOCK=24000000
CONFIG_DEBUG_UART_BOARD_INIT=y
CONFIG_IDENT_STRING=""
CONFIG_SYS_CLK_FREQ=0
CONFIG_ARMV8_SET_SMPEN=y
CONFIG_PSCI_RESET=y
CONFIG_ARMV8_CRYPTO=y
CONFIG_ARMV8_CE_SHA1=y
CONFIG_ARMV8_CE_SHA256=y
CONFIG_SYS_MEM_TOP_HIDE=0x0
CONFIG_TPL_MAX_SIZE=0x2e000
CONFIG_SPL_PAYLOAD="tpl/u-boot-with-tpl.bin"
CONFIG_BUILD_TARGET=""
CONFIG_FWU_NUM_BANKS=2
CONFIG_FWU_NUM_IMAGES_PER_BANK=2
CONFIG_TPL_SIZE_LIMIT=0x0
CONFIG_DEBUG_UART=y
CONFIG_SYS_LITTLE_ENDIAN=y
CONFIG_LOCALVERSION="-msc"
CONFIG_CC_IS_GCC=y
CONFIG_GCC_VERSION=130300
CONFIG_CLANG_VERSION=0
CONFIG_CC_OPTIMIZE_FOR_SIZE=y
CONFIG_ARCH_SUPPORTS_LTO=y
CONFIG_CC_HAS_ASM_INLINE=y
CONFIG_ENV_VARS_UBOOT_CONFIG=y
CONFIG_SYS_MALLOC_F=y
CONFIG_EXPERT=y
CONFIG_SYS_MALLOC_CLEAR_ON_INIT=y
CONFIG_SPL_SYS_MALLOC_CLEAR_ON_INIT=y
CONFIG_PHYS_64BIT=y
CONFIG_FDT_64BIT=y
CONFIG_SPL_IMAGE="spl/u-boot-spl.bin"
CONFIG_PLATFORM_ELFENTRY="_start"
CONFIG_STACK_SIZE=0x1000000
CONFIG_SYS_SRAM_BASE=0x0
CONFIG_SYS_SRAM_SIZE=0x0
CONFIG_HAVE_TEXT_BASE=y
CONFIG_SYS_UBOOT_START=0x00200000
CONFIG_EFI_LOADER=y
CONFIG_EFI_BINARY_EXEC=y
CONFIG_EFI_HAVE_RUNTIME_RESET=y
CONFIG_EFI_VARIABLE_FILE_STORE=y
CONFIG_EFI_VAR_BUF_SIZE=131072
CONFIG_EFI_PLATFORM_LANG_CODES="en-US"
CONFIG_EFI_CAPSULE_MAX=15
CONFIG_EFI_DEVICE_PATH_TO_TEXT=y
CONFIG_EFI_DEVICE_PATH_UTIL=y
CONFIG_EFI_DT_FIXUP=y
CONFIG_EFI_LOADER_HII=y
CONFIG_EFI_UNICODE_COLLATION_PROTOCOL2=y
CONFIG_EFI_UNICODE_CAPITALIZATION=y
CONFIG_EFI_RNG_PROTOCOL=y
CONFIG_EFI_LOAD_FILE2_INITRD=y
CONFIG_EFI_ECPT=y
CONFIG_EFI_EBBR_2_1_CONFORMANCE=y
CONFIG_EFI_BOOTMGR=y
CONFIG_BOOTEFI_HELLO_COMPILE=y
CONFIG_BOOTEFI_TESTAPP_COMPILE=y
CONFIG_FIT=y
CONFIG_FIT_EXTERNAL_OFFSET=0x0
CONFIG_FIT_FULL_CHECK=y
CONFIG_FIT_SIGNATURE=y
CONFIG_FIT_SIGNATURE_MAX_SIZE=0x10000000
CONFIG_FIT_PRINT=y
CONFIG_SPL_FIT=y
CONFIG_SPL_FIT_FULL_CHECK=y
CONFIG_SPL_FIT_SIGNATURE=y
CONFIG_SPL_FIT_SIGNATURE_MAX_SIZE=0x10000000
CONFIG_SPL_LOAD_FIT=y
CONFIG_SPL_LOAD_FIT_ADDRESS=0x0
CONFIG_PXE_UTILS=y
CONFIG_BOOT_DEFAULTS_FEATURES=y
CONFIG_BOOT_DEFAULTS_CMDS=y
CONFIG_BOOT_DEFAULTS=y
CONFIG_BOOTSTD=y
CONFIG_BOOTSTD_FULL=y
CONFIG_BOOTSTD_DEFAULTS=y
CONFIG_BOOTSTD_BOOTCOMMAND=y
CONFIG_BOOTMETH_GLOBAL=y
CONFIG_BOOTMETH_EXTLINUX=y
CONFIG_BOOTMETH_EXTLINUX_PXE=y
CONFIG_BOOTMETH_EFILOADER=y
CONFIG_BOOTMETH_EFI_BOOTMGR=y
CONFIG_BOOTMETH_VBE=y
CONFIG_BOOTMETH_DISTRO=y
CONFIG_BOOTMETH_VBE_REQUEST=y
CONFIG_BOOTMETH_VBE_SIMPLE=y
CONFIG_BOOTMETH_VBE_SIMPLE_OS=y
CONFIG_BOOTMETH_SCRIPT=y
CONFIG_LEGACY_IMAGE_FORMAT=y
CONFIG_SUPPORT_RAW_INITRD=y
CONFIG_SYS_BOOT_RAMDISK_HIGH=y
CONFIG_AUTOBOOT=y
CONFIG_BOOTDELAY=2
CONFIG_ARCH_FIXUP_FDT_MEMORY=y
CONFIG_USE_BOOTCOMMAND=y
CONFIG_BOOTCOMMAND="bootflow scan -lb"
CONFIG_DEFAULT_FDT_FILE="rockchip/rk3399-orangepi.dtb"
CONFIG_MENU=y
CONFIG_SYS_CBSIZE=1024
CONFIG_SYS_PBSIZE=1044
CONFIG_LOGLEVEL=6
CONFIG_SPL_LOGLEVEL=6
CONFIG_TPL_LOGLEVEL=6
CONFIG_PRE_CONSOLE_BUFFER=y
CONFIG_CONSOLE_FLUSH_SUPPORT=y
CONFIG_DISPLAY_CPUINFO=y
CONFIG_DISPLAY_BOARDINFO=y
CONFIG_DISPLAY_BOARDINFO_LATE=y
CONFIG_EVENT=y
CONFIG_EVENT_DYNAMIC=y
CONFIG_BOARD_LATE_INIT=y
CONFIG_LAST_STAGE_INIT=y
CONFIG_MISC_INIT_R=y
CONFIG_HASH=y
CONFIG_SPL_HASH=y
CONFIG_SUPPORT_SPL=y
CONFIG_SUPPORT_TPL=y
CONFIG_SPL_FRAMEWORK=y
CONFIG_SPL_MAX_SIZE=0x40000
CONFIG_SPL_PAD_TO=0x7f8000
CONFIG_SPL_BSS_LIMIT=y
CONFIG_SPL_SYS_STACK_F_CHECK_BYTE=0xaa
CONFIG_SPL_BINMAN_SYMBOLS=y
CONFIG_SPL_BINMAN_UBOOT_SYMBOLS=y
CONFIG_SPL_BOARD_INIT=y
CONFIG_SPL_LOAD_BLOCK=y
CONFIG_SPL_SYS_MALLOC_SIMPLE=y
CONFIG_SPL_SHARES_INIT_SP_ADDR=y
CONFIG_SPL_SEPARATE_BSS=y
CONFIG_SPL_BANNER_PRINT=y
CONFIG_SPL_SYS_MMCSD_RAW_MODE=y
CONFIG_SYS_MMCSD_RAW_MODE_U_BOOT_USE_SECTOR=y
CONFIG_SYS_MMCSD_RAW_MODE_U_BOOT_SECTOR=0x4000
CONFIG_SYS_MMCSD_RAW_MODE_U_BOOT_DATA_PART_OFFSET=0x0
CONFIG_SPL_CRYPTO=y
CONFIG_SYS_MMCSD_FS_BOOT=y
CONFIG_SYS_MMCSD_FS_BOOT_PARTITION=1
CONFIG_SPL_DM_SPI_FLASH=y
CONFIG_SPL_ATF=y
CONFIG_SPL_ATF_NO_PLATFORM_PARAM=y
CONFIG_SPL_TARGET=""
CONFIG_TPL=y
CONFIG_TPL_BINMAN_SYMBOLS=y
CONFIG_TPL_BINMAN_UBOOT_SYMBOLS=y
CONFIG_TPL_FRAMEWORK=y
CONFIG_TPL_BANNER_PRINT=y
CONFIG_TPL_SYS_MALLOC_SIMPLE=y
CONFIG_TPL_SEPARATE_BSS=y
CONFIG_TPL_NEEDS_SEPARATE_STACK=y
CONFIG_TPL_BOOTROM_SUPPORT=y
CONFIG_IMAGE_SIGN_INFO=y
CONFIG_SPL_IMAGE_SIGN_INFO=y
CONFIG_CMDLINE=y
CONFIG_HUSH_PARSER=y
CONFIG_HUSH_OLD_PARSER=y
CONFIG_CMDLINE_EDITING=y
CONFIG_AUTO_COMPLETE=y
CONFIG_SYS_LONGHELP=y
CONFIG_SYS_PROMPT="=> "
CONFIG_SYS_PROMPT_HUSH_PS2="> "
CONFIG_SYS_MAXARGS=64
CONFIG_SYS_XTRACE=y
CONFIG_CMD_BDI=y
CONFIG_CMD_CONSOLE=y
CONFIG_CMD_BOOTD=y
CONFIG_CMD_BOOTM=y
CONFIG_CMD_BOOTDEV=y
CONFIG_CMD_BOOTFLOW=y
CONFIG_CMD_BOOTFLOW_FULL=y
CONFIG_CMD_BOOTMETH=y
CONFIG_BOOTM_EFI=y
CONFIG_BOOTM_ELF=y
CONFIG_CMD_BOOTZ=y
CONFIG_CMD_BOOTI=y
CONFIG_BOOTM_LINUX=y
CONFIG_BOOTM_NETBSD=y
CONFIG_BOOTM_PLAN9=y
CONFIG_BOOTM_RTEMS=y
CONFIG_CMD_VBE=y
CONFIG_BOOTM_VXWORKS=y
CONFIG_CMD_BOOTEFI=y
CONFIG_CMD_BOOTEFI_BINARY=y
CONFIG_CMD_BOOTEFI_BOOTMGR=y
CONFIG_CMD_ELF=y
CONFIG_CMD_ELF_BOOTVX=y
CONFIG_CMD_FDT=y
CONFIG_CMD_GO=y
CONFIG_CMD_RUN=y
CONFIG_CMD_IMI=y
CONFIG_CMD_XIMG=y
CONFIG_SYS_XIMG_LEN=0x800000
CONFIG_CMD_EXPORTENV=y
CONFIG_CMD_IMPORTENV=y
CONFIG_CMD_EDITENV=y
CONFIG_CMD_SAVEENV=y
CONFIG_CMD_ENV_EXISTS=y
CONFIG_CMD_CRC32=y
CONFIG_CMD_MEMORY=y
CONFIG_CMD_RANDOM=y
CONFIG_CMD_LZMADEC=y
CONFIG_CMD_UNLZ4=y
CONFIG_CMD_UNZIP=y
CONFIG_CMD_DM=y
CONFIG_CMD_GPT=y
CONFIG_CMD_LOADB=y
CONFIG_CMD_LOADS=y
CONFIG_CMD_LOADXY_TIMEOUT=90
CONFIG_CMD_MMC=y
CONFIG_CMD_PART=y
CONFIG_CMD_PINMUX=y
CONFIG_CMD_SF=y
CONFIG_CMD_USB=y
CONFIG_CMD_ECHO=y
CONFIG_CMD_ITEST=y
CONFIG_CMD_SOURCE=y
CONFIG_CMD_NET=y
CONFIG_CMD_BOOTP=y
CONFIG_BOOTP_BOOTPATH=y
CONFIG_BOOTP_DNS=y
CONFIG_BOOTP_GATEWAY=y
CONFIG_BOOTP_HOSTNAME=y
CONFIG_BOOTP_SUBNETMASK=y
CONFIG_BOOTP_PXE=y
CONFIG_BOOTP_PXE_CLIENTARCH=0x16
CONFIG_BOOTP_VCI_STRING="U-Boot.armv8"
CONFIG_NET_TFTP_VARS=y
CONFIG_CMD_DHCP=y
CONFIG_CMD_MII=y
CONFIG_CMD_MDIO=y
CONFIG_CMD_PING=y
CONFIG_CMD_TFTPBOOT=y
CONFIG_CMD_PXE=y
CONFIG_CMD_BLOCK_CACHE=y
CONFIG_CMD_EFICONFIG=y
CONFIG_CMD_TIME=y
CONFIG_CMD_SLEEP=y
CONFIG_CMD_EXT2=y
CONFIG_CMD_EXT4=y
CONFIG_CMD_FAT=y
CONFIG_CMD_FS_GENERIC=y
CONFIG_MTDIDS_DEFAULT=""
CONFIG_MTDPARTS_DEFAULT=""
CONFIG_PARTITIONS=y
CONFIG_SPL_PARTITIONS=y
CONFIG_DOS_PARTITION=y
CONFIG_SPL_DOS_PARTITION=y
CONFIG_ISO_PARTITION=y
CONFIG_EFI_PARTITION=y
CONFIG_EFI_PARTITION_ENTRIES_NUMBERS=128
CONFIG_EFI_PARTITION_ENTRIES_OFF=0
CONFIG_SPL_EFI_PARTITION=y
CONFIG_PARTITION_UUIDS=y
CONFIG_SPL_PARTITION_UUIDS=y
CONFIG_PARTITION_TYPE_GUID=y
CONFIG_SUPPORT_OF_CONTROL=y
CONFIG_PYLIBFDT=y
CONFIG_DTOC=y
CONFIG_BINMAN=y
CONFIG_OF_CONTROL=y
CONFIG_OF_REAL=y
CONFIG_SPL_OF_CONTROL=y
CONFIG_TPL_OF_CONTROL=y
CONFIG_OF_LIVE=y
CONFIG_OF_UPSTREAM=y
CONFIG_OF_SEPARATE=y
CONFIG_DEVICE_TREE_INCLUDES=""
CONFIG_OF_LIST="rockchip/rk3399-orangepi"
CONFIG_OF_OVERLAY_LIST=""
CONFIG_SPL_OF_LIST="rockchip/rk3399-orangepi"
CONFIG_OF_TAG_MIGRATE=y
CONFIG_OF_SPL_REMOVE_PROPS="clock-names interrupt-parent assigned-clocks assigned-clock-rates assigned-clock-parents"
CONFIG_SPL_OF_REAL=y
CONFIG_TPL_OF_REAL=y
CONFIG_ENV_SUPPORT=y
CONFIG_SAVEENV=y
CONFIG_ENV_MIN_ENTRIES=64
CONFIG_ENV_MAX_ENTRIES=512
CONFIG_ENV_IS_IN_MMC=y
CONFIG_SYS_RELOC_GD_ENV_ADDR=y
CONFIG_SYS_MMC_ENV_DEV=0
CONFIG_SYS_MMC_ENV_PART=0
CONFIG_NET=y
CONFIG_ARP_TIMEOUT=5000
CONFIG_NET_RETRY_COUNT=5
CONFIG_TFTP_WINDOWSIZE=1
CONFIG_SERVERIP_FROM_PROXYDHCP_DELAY_MS=100
CONFIG_BOOTP_MAX_ROOT_PATH_LEN=64
CONFIG_BOOTDEV_ETH=y
CONFIG_TFTP_BLOCKSIZE=1468
CONFIG_SYS_RX_ETH_BUFFER=4
CONFIG_DM=y
CONFIG_SPL_DM=y
CONFIG_TPL_DM=y
CONFIG_DM_DEVICE_REMOVE=y
CONFIG_DM_EVENT=y
CONFIG_DM_STDIO=y
CONFIG_DM_SEQ_ALIAS=y
CONFIG_SPL_DM_SEQ_ALIAS=y
CONFIG_SPL_DM_INLINE_OFNODE=y
CONFIG_TPL_DM_INLINE_OFNODE=y
CONFIG_REGMAP=y
CONFIG_SPL_REGMAP=y
CONFIG_TPL_REGMAP=y
CONFIG_SYSCON=y
CONFIG_SPL_SYSCON=y
CONFIG_TPL_SYSCON=y
CONFIG_SIMPLE_BUS=y
CONFIG_SPL_SIMPLE_BUS=y
CONFIG_OF_TRANSLATE=y
CONFIG_OFNODE_MULTI_TREE=y
CONFIG_OFNODE_MULTI_TREE_MAX=4
CONFIG_BOUNCE_BUFFER=y
CONFIG_ADC=y
CONFIG_SARADC_ROCKCHIP=y
CONFIG_BLK=y
CONFIG_SPL_LEGACY_BLOCK=y
CONFIG_SPL_BLK=y
CONFIG_BLOCK_CACHE=y
CONFIG_CLK=y
CONFIG_SPL_CLK=y
CONFIG_TPL_CLK=y
CONFIG_CAAM_64BIT=y
CONFIG_FIRMWARE=y
CONFIG_ARM_PSCI_FW=y
CONFIG_GPIO=y
CONFIG_SPL_DM_GPIO=y
CONFIG_ROCKCHIP_GPIO=y
CONFIG_I2C=y
CONFIG_DM_I2C=y
CONFIG_SPL_DM_I2C=y
CONFIG_SYS_I2C_ROCKCHIP=y
CONFIG_INPUT=y
CONFIG_MISC=y
CONFIG_SPL_MISC=y
CONFIG_TPL_MISC=y
CONFIG_ROCKCHIP_EFUSE=y
CONFIG_ROCKCHIP_IODOMAIN=y
CONFIG_MMC=y
CONFIG_MMC_WRITE=y
CONFIG_DM_MMC=y
CONFIG_SPL_DM_MMC=y
CONFIG_MMC_QUIRKS=y
CONFIG_SYS_MMC_MAX_BLK_COUNT=65535
CONFIG_MMC_HW_PARTITIONING=y
CONFIG_MMC_VERBOSE=y
CONFIG_MMC_DW=y
CONFIG_MMC_DW_ROCKCHIP=y
CONFIG_MMC_SDHCI=y
CONFIG_MMC_SDHCI_SDMA=y
CONFIG_SPL_MMC_SDHCI_SDMA=y
CONFIG_MMC_SDHCI_ADMA_64BIT=y
CONFIG_MMC_SDHCI_ROCKCHIP=y
CONFIG_MTD=y
CONFIG_DM_SPI_FLASH=y
CONFIG_SPI_FLASH=y
CONFIG_SPI_FLASH_SMART_HWCAPS=y
CONFIG_SPI_FLASH_LOCK=y
CONFIG_SPI_FLASH_UNLOCK_ALL=y
CONFIG_SPI_FLASH_USE_4K_SECTORS=y
CONFIG_PHYLIB=y
CONFIG_PHY_ANEG_TIMEOUT=4000
CONFIG_PHY_REALTEK=y
CONFIG_PHY_RESET_DELAY=0
CONFIG_ETH=y
CONFIG_DM_ETH=y
CONFIG_DM_ETH_PHY=y
CONFIG_NETDEVICES=y
CONFIG_PHY_GIGE=y
CONFIG_ETH_DESIGNWARE=y
CONFIG_GMAC_ROCKCHIP=y
CONFIG_PHY=y
CONFIG_PHY_ROCKCHIP_INNO_USB2=y
CONFIG_PHY_ROCKCHIP_TYPEC=y
CONFIG_PINCTRL=y
CONFIG_PINCTRL_FULL=y
CONFIG_PINCTRL_GENERIC=y
CONFIG_PINMUX=y
CONFIG_PINCONF_RECURSIVE=y
CONFIG_SPL_PINCTRL=y
CONFIG_SPL_PINCTRL_FULL=y
CONFIG_SPL_PINCTRL_GENERIC=y
CONFIG_SPL_PINMUX=y
CONFIG_SPL_PINCONF_RECURSIVE=y
CONFIG_PINCTRL_ROCKCHIP=y
CONFIG_SPL_PINCTRL_ROCKCHIP=y
CONFIG_POWER=y
CONFIG_DM_PMIC=y
CONFIG_SPL_DM_PMIC=y
CONFIG_PMIC_CHILDREN=y
CONFIG_SPL_PMIC_CHILDREN=y
CONFIG_PMIC_RK8XX=y
CONFIG_DM_REGULATOR=y
CONFIG_REGULATOR_PWM=y
CONFIG_DM_REGULATOR_COMMON=y
CONFIG_SPL_DM_REGULATOR_COMMON=y
CONFIG_DM_REGULATOR_FIXED=y
CONFIG_SPL_DM_REGULATOR_FIXED=y
CONFIG_REGULATOR_RK8XX=y
CONFIG_DM_PWM=y
CONFIG_PWM_ROCKCHIP=y
CONFIG_RAM=y
CONFIG_SPL_RAM=y
CONFIG_TPL_RAM=y
CONFIG_RAM_ROCKCHIP=y
CONFIG_ROCKCHIP_SDRAM_COMMON=y
CONFIG_RAM_ROCKCHIP_DEBUG=y
CONFIG_REMOTEPROC_MAX_FW_SIZE=0x10000
CONFIG_RESET_ROCKCHIP=y
CONFIG_DM_RNG=y
CONFIG_RNG_ROCKCHIP=y
CONFIG_SERIAL=y
CONFIG_BAUDRATE=1500000
CONFIG_REQUIRE_SERIAL_CONSOLE=y
CONFIG_SERIAL_PRESENT=y
CONFIG_SPL_SERIAL_PRESENT=y
CONFIG_TPL_SERIAL_PRESENT=y
CONFIG_DM_SERIAL=y
CONFIG_SPL_DM_SERIAL=y
CONFIG_TPL_DM_SERIAL=y
CONFIG_DEBUG_UART_NS16550=y
CONFIG_SPL_DEBUG_UART_BASE=0xFF1A0000
CONFIG_TPL_DEBUG_UART_BASE=0xFF1A0000
CONFIG_DEBUG_UART_SHIFT=2
CONFIG_SYS_NS16550=y
CONFIG_SYS_NS16550_MEM32=y
CONFIG_SPI=y
CONFIG_DM_SPI=y
CONFIG_SPI_MEM=y
CONFIG_SYSRESET=y
CONFIG_SPL_SYSRESET=y
CONFIG_TPL_SYSRESET=y
CONFIG_SYSRESET_CMD_RESET=y
CONFIG_USB=y
CONFIG_DM_USB=y
CONFIG_SPL_DM_USB=y
CONFIG_USB_HOST=y
CONFIG_USB_XHCI_HCD=y
CONFIG_USB_EHCI_HCD=y
CONFIG_USB_EHCI_GENERIC=y
CONFIG_USB_DWC3=y
CONFIG_USB_DWC3_GENERIC=y
CONFIG_USB_STORAGE=y
CONFIG_USB_HUB_DEBOUNCE_TIMEOUT=1000
CONFIG_USB_HOST_ETHER=y
CONFIG_USB_ETHER_ASIX=y
CONFIG_USB_ETHER_ASIX88179=y
CONFIG_USB_ETHER_MCS7830=y
CONFIG_USB_ETHER_RTL8152=y
CONFIG_USB_ETHER_SMSC95XX=y
CONFIG_FS_EXT4=y
CONFIG_FS_FAT=y
CONFIG_FAT_WRITE=y
CONFIG_FS_FAT_MAX_CLUSTSIZE=65536
CONFIG_BINMAN_FDT=y
CONFIG_CHARSET=y
CONFIG_LIB_UUID=y
CONFIG_RANDOM_UUID=y
CONFIG_SPL_LIB_UUID=y
CONFIG_PRINTF=y
CONFIG_SPL_PRINTF=y
CONFIG_TPL_PRINTF=y
CONFIG_SPRINTF=y
CONFIG_SPL_SPRINTF=y
CONFIG_TPL_SPRINTF=y
CONFIG_STRTO=y
CONFIG_SPL_STRTO=y
CONFIG_TPL_STRTO=y
CONFIG_SYS_HZ=1000
CONFIG_SPL_USE_TINY_PRINTF=y
CONFIG_TPL_USE_TINY_PRINTF=y
CONFIG_REGEX=y
CONFIG_LIB_RAND=y
CONFIG_SUPPORT_ACPI=y
CONFIG_TPL_TINY_MEMSET=y
CONFIG_LEGACY_CRYPTO=y
CONFIG_LEGACY_CRYPTO_BASIC=y
CONFIG_SHA1_LEGACY=y
CONFIG_SHA256_LEGACY=y
CONFIG_MD5_LEGACY=y
CONFIG_SPL_SHA1_LEGACY=y
CONFIG_SPL_SHA256_LEGACY=y
CONFIG_LEGACY_CRYPTO_CERT=y
CONFIG_RSA=y
CONFIG_SPL_RSA=y
CONFIG_SPL_RSA_VERIFY=y
CONFIG_RSA_VERIFY=y
CONFIG_RSA_SOFTWARE_EXP=y
CONFIG_SHA1=y
CONFIG_SHA256=y
CONFIG_SPL_CRC32=y
CONFIG_SPL_SHA1=y
CONFIG_SPL_SHA256=y
CONFIG_MD5=y
CONFIG_CRC8=y
CONFIG_CRC32=y
CONFIG_LZ4=y
CONFIG_LZMA=y
CONFIG_GZIP=y
CONFIG_ZLIB=y
CONFIG_VPL_LZMA=y
CONFIG_ERRNO_STR=y
CONFIG_OF_LIBFDT=y
CONFIG_OF_LIBFDT_ASSUME_MASK=0x0
CONFIG_SYS_FDT_PAD=0x3000
CONFIG_SPL_OF_LIBFDT=y
CONFIG_TPL_OF_LIBFDT=y
CONFIG_TPL_OF_LIBFDT_ASSUME_MASK=0xff
CONFIG_GENERATE_SMBIOS_TABLE=y
CONFIG_SMBIOS=y
CONFIG_LIB_ELF=y
CONFIG_LMB=y
CONFIG_MKIMAGE_DTC_PATH="dtc"
CONFIG_TOOLS_CRC32=y
CONFIG_TOOLS_LIBCRYPTO=y
CONFIG_TOOLS_KWBIMAGE=y
CONFIG_TOOLS_FIT=y
CONFIG_TOOLS_FIT_FULL_CHECK=y
CONFIG_TOOLS_FIT_PRINT=y
CONFIG_TOOLS_FIT_RSASSA_PSS=y
CONFIG_TOOLS_FIT_SIGNATURE=y
CONFIG_TOOLS_FIT_SIGNATURE_MAX_SIZE=0x10000000
CONFIG_TOOLS_FIT_VERBOSE=y
CONFIG_TOOLS_MD5=y
CONFIG_TOOLS_OF_LIBFDT=y
CONFIG_TOOLS_SHA1=y
CONFIG_TOOLS_SHA256=y
CONFIG_TOOLS_SHA384=y
CONFIG_TOOLS_SHA512=y
CONFIG_TOOLS_MKEFICAPSULE=y
```
